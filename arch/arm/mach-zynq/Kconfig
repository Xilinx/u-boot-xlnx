## arch/arm/mach-zynq/Kconfig
```kconfig
if ARCH_ZYNQ

config ZYNQ_CUSTOM_INIT
	bool "Use custom ps7_init provided by Xilinx tool"
	help
	  U-Boot includes ps7_init_gpl.[ch] for some Zynq board variants.
	  If you want to override them with customized ones
	  or ps7_init code for your board is missing, please say Y here
	  and add ones into board/xilinx/zynq/custom_hw_platform/ directory.

choice
	prompt "Xilinx Zynq board select"
	default TARGET_ZYNQ_ZC702

config TARGET_ZYNQ_ZED
	bool "Zynq ZedBoard"

config TARGET_ZYNQ_MICROZED
	bool "Zynq MicroZed"

config TARGET_ZYNQ_PICOZED
	bool "Zynq PicoZed"

config TARGET_ZYNQ_ZC702
	bool "Zynq ZC702 Board"

config TARGET_ZYNQ_ZC706
	bool "Zynq ZC706 Board"

config TARGET_ZYNQ_ZC770
	bool "Zynq ZC770 Board"
	select ZYNQ_CUSTOM_INIT

config TARGET_ZYNQ_ZYBO
	bool "Zynq Zybo Board"

config TARGET_ZYNQ_AFX
	bool "Zynq AFX Board"
	select ZYNQ_CUSTOM_INIT

config TARGET_ZYNQ_CSE
	bool "Zynq CSE Board"
	select ZYNQ_CUSTOM_INIT

config TARGET_ZYNQ_CC108
	bool "Zynq CC108 Board"
	select ZYNQ_CUSTOM_INIT

config TARGET_PIKSIV3_MICROZED_FULL
	bool "Piksiv3 MicroZed Full"
	select SUPPORT_TPL

config TARGET_PIKSIV3_MICROZED_PROD
	bool "Piksiv3 MicroZed Prod"
	select SUPPORT_TPL

config TARGET_PIKSIV3_MICROZED_DEV
	bool "Piksiv3 MicroZed Dev"
	select SUPPORT_TPL

config TARGET_PIKSIV3_PROD_FULL
	bool "Piksiv3 Prod Full"
	select SUPPORT_TPL

config TARGET_PIKSIV3_PROD_PROD
	bool "Piksiv3 Prod Prod"
	select SUPPORT_TPL

config TARGET_PIKSIV3_PROD_DEV
	bool "Piksiv3 Prod Dev"
	select SUPPORT_TPL

endchoice

config SYS_BOARD
	default "zynq"

config SYS_VENDOR
	default "xilinx"

config SYS_SOC
	default "zynq"

config SYS_CONFIG_NAME
	default "zynq_zed" if TARGET_ZYNQ_ZED
	default "zynq_microzed" if TARGET_ZYNQ_MICROZED
	default "zynq_picozed" if TARGET_ZYNQ_PICOZED
	default "zynq_zc70x" if TARGET_ZYNQ_ZC702 || TARGET_ZYNQ_ZC706
	default "zynq_zc770" if TARGET_ZYNQ_ZC770
	default "zynq_zybo" if TARGET_ZYNQ_ZYBO
	default "zynq_cse" if TARGET_ZYNQ_CSE
	default "zynq_afx" if TARGET_ZYNQ_AFX
	default "zynq_cc108" if TARGET_ZYNQ_CC108
	default "piksiv3_microzed_full" if TARGET_PIKSIV3_MICROZED_FULL
	default "piksiv3_microzed_prod" if TARGET_PIKSIV3_MICROZED_PROD
	default "piksiv3_microzed_dev" if TARGET_PIKSIV3_MICROZED_DEV
	default "piksiv3_prod_full" if TARGET_PIKSIV3_PROD_FULL
	default "piksiv3_prod_prod" if TARGET_PIKSIV3_PROD_PROD
	default "piksiv3_prod_dev" if TARGET_PIKSIV3_PROD_DEV

endif
```

## configs/piksiv3_microzed_qspi_defconfig
```kconfig
CONFIG_ARM=y
CONFIG_ARCH_ZYNQ=y
CONFIG_TARGET_PIKSIV3_MICROZED_QSPI=y
CONFIG_DEFAULT_DEVICE_TREE="zynq-microzed"
CONFIG_SPL=y
CONFIG_TPL=y
CONFIG_FIT=y
CONFIG_FIT_VERBOSE=y
CONFIG_FIT_SIGNATURE=y
CONFIG_HUSH_PARSER=y
CONFIG_SYS_PROMPT="Piksi> "
# CONFIG_CMD_CONSOLE is not set
# CONFIG_CMD_BOOTD is not set
# CONFIG_CMD_ELF is not set
# CONFIG_CMD_IMI is not set
# CONFIG_CMD_IMLS is not set
# CONFIG_CMD_XIMG is not set
# CONFIG_CMD_EXPORTENV is not set
# CONFIG_CMD_IMPORTENV is not set
# CONFIG_CMD_EDITENV is not set
# CONFIG_CMD_SAVEENV is not set
# CONFIG_CMD_ENV_EXISTS is not set
# CONFIG_CMD_DM is not set
# CONFIG_CMD_LOADB is not set
# CONFIG_CMD_LOADS is not set
# CONFIG_CMD_FLASH is not set
# CONFIG_CMD_FPGA is not set
# CONFIG_CMD_ITEST is not set
# CONFIG_CMD_SOURCE is not set
# CONFIG_CMD_SETEXPR is not set
# CONFIG_CMD_NET is not set
# CONFIG_CMD_NFS is not set
# CONFIG_CMD_MISC is not set
CONFIG_OF_EMBED=y
CONFIG_SPL_DM_SEQ_ALIAS=y
CONFIG_SPI_FLASH=y
CONFIG_SPI_FLASH_BAR=y
CONFIG_SPI_FLASH_SPANSION=y
CONFIG_SPI_FLASH_STMICRO=y
CONFIG_SPI_FLASH_WINBOND=y
CONFIG_ZYNQ_QSPI=y
CONFIG_REGEX=y
CONFIG_LIB_RAND=y
```

## configs/piksiv3_prod_full_defconfig
```kconfig
CONFIG_ARM=y
CONFIG_ARCH_ZYNQ=y
CONFIG_TARGET_PIKSIV3_PROD_FULL=y
CONFIG_BOOT_INIT_FILE="board/xilinx/zynq/piksiv3_prod_hw_platform/reg_init.txt"
CONFIG_DEFAULT_DEVICE_TREE="piksiv3_prod"
CONFIG_SPL=y
CONFIG_TPL=y
CONFIG_FIT=y
CONFIG_FIT_VERBOSE=y
CONFIG_FIT_SIGNATURE=y
CONFIG_SYS_PROMPT="Piksi> "
# CONFIG_CMD_IMLS is not set
# CONFIG_CMD_FLASH is not set
CONFIG_CMD_GPIO=y
# CONFIG_CMD_SETEXPR is not set
CONFIG_OF_EMBED=y
CONFIG_NET_RANDOM_ETHADDR=y
CONFIG_SPL_DM_SEQ_ALIAS=y
CONFIG_SPI_FLASH=y
CONFIG_SPI_FLASH_BAR=y
CONFIG_SPI_FLASH_SPANSION=y
CONFIG_SPI_FLASH_STMICRO=y
CONFIG_SPI_FLASH_WINBOND=y
CONFIG_ZYNQ_GEM=y
CONFIG_ZYNQ_QSPI=y
```

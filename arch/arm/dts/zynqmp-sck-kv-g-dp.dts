// SPDX-License-Identifier: GPL-2.0
/*
 * dts file for KV260 DP subsystem
 *
 * (C) Copyright 2021, Xilinx, Inc.
 *
 * Michal Simek <michal.simek@xilinx.com>
 */

/dts-v1/;
/plugin/;

/{
	compatible = "xlnx,zynqmp-sk-kv260-revB",
		     "xlnx,zynqmp-sk-kv260-revA",
		     "xlnx,zynqmp-sk-kv260-revY",
		     "xlnx,zynqmp-sk-kv260-revZ",
		     "xlnx,zynqmp-sk-kv260", "xlnx,zynqmp";

	fragment4 {
		target = <&zynqmp_dpsub>;
		__overlay__ {
			status = "okay";
		};
	};
};

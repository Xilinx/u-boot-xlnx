// SPDX-License-Identifier: GPL-2.0
/*
 * dts file for AMD Versal2 with PM
 *
 * Copyright (C) 2026, Advanced Micro Devices, Inc.
 *
 * Michal Simek <michal.simek@amd.com>
 */

&cpu0 {
	clocks = <&scmi_clk SCMI_CLK_VERSAL2_ACPU_0>;
};

&cpu100 {
	clocks = <&scmi_clk SCMI_CLK_VERSAL2_ACPU_0>;
};

&cpu200 {
	clocks = <&scmi_clk SCMI_CLK_VERSAL2_ACPU_0>;
};

&cpu300 {
	clocks = <&scmi_clk SCMI_CLK_VERSAL2_ACPU_0>;
};
